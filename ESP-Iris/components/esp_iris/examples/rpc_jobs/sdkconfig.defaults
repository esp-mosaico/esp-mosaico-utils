## ESP-Iris/components/esp_iris/test_apps/disabled/sdkconfig.defaults
```kconfig
CONFIG_IDF_TARGET="esp32s31"
CONFIG_IDF_EXPERIMENTAL_FEATURES=y
CONFIG_ESPTOOLPY_FLASHMODE_QIO=y
# CONFIG_ESP_IRIS_ENABLE is not set
```

## ESP-Iris/components/esp_iris/test_apps/services_uart/sdkconfig.defaults
```kconfig
CONFIG_IDF_TARGET="esp32s31"
CONFIG_IDF_EXPERIMENTAL_FEATURES=y
CONFIG_ESPTOOLPY_FLASHMODE_QIO=y
CONFIG_COMPILER_OPTIMIZATION_PERF=y
CONFIG_ESPTOOLPY_FLASHSIZE_2MB=y
CONFIG_PARTITION_TABLE_CUSTOM=y
CONFIG_PARTITION_TABLE_CUSTOM_FILENAME="../services_usb/partitions.csv"
CONFIG_ESP_CONSOLE_UART_DEFAULT=y
CONFIG_ESP_CONSOLE_SECONDARY_NONE=y
# Stock monitor and Iris 0.2 share the standard printable console contract.
CONFIG_ESP_IRIS_TRANSPORT_UART=y
CONFIG_ESP_IRIS_UART_NUM=0
CONFIG_ESP_IRIS_UART_BAUDRATE=115200
CONFIG_ESP_IRIS_MEDIA_LATEST_BYTES=3840
CONFIG_ESP_IRIS_MAX_RPC_HANDLERS=12
CONFIG_ESP_IRIS_MAX_FILE_VOLUMES=4
CONFIG_ESP_IRIS_TASK_STACK_SIZE=3328

CONFIG_ESP_IRIS_FIRMWARE_ROLE=1
```

## ESP-Iris/components/esp_iris/test_apps/services_usb/main/Kconfig.projbuild
```kconfig
menu "Iris services private network fixture"
config ESP_IRIS_TEST_WIFI_SSID
    string "Private test Wi-Fi SSID"
    default ""
config ESP_IRIS_TEST_WIFI_PASSWORD
    string "Private test Wi-Fi password"
    default ""
config ESP_IRIS_TEST_PAIRING_TOKEN
    string "Private initial 64-hex pairing token"
    default ""
config ESP_IRIS_TEST_NEXT_PAIRING_TOKEN
    string "Private rotated 64-hex pairing token"
    default ""
endmenu
```

## mosaico-tools/bootloader_components/main/Kconfig
```kconfig
menu "Factory recovery boot"

    config FACTORY_RECOVERY_BOOT_GPIO
        int "GPIO used to request factory recovery"
        range 0 61 if IDF_TARGET_ESP32S31
        default 7
        help
            The bootloader configures this pin as an input with its internal
            pull-up enabled. Holding it low during reset selects the factory
            recovery image for this boot only.

    config FACTORY_RECOVERY_BOOT_DEBOUNCE_MS
        int "Low-level debounce time (milliseconds)"
        range 0 1000
        default 50
        help
            The pin must remain low for this duration. A released pin adds no
            debounce delay to normal startup.

    config FACTORY_RECOVERY_LONG_PRESS_GPIO
        int "GPIO used to request factory recovery by long press"
        range 0 61 if IDF_TARGET_ESP32S31
        default 57
        help
            The bootloader only reads this pin, with its internal pull-up
            enabled, and never drives it. Holding it low for the long-press
            time during reset selects the factory recovery image for this boot
            only.

    config FACTORY_RECOVERY_LONG_PRESS_MS
        int "Long-press time (milliseconds)"
        range 0 3000
        default 300
        help
            The long-press pin must remain low for this duration after the boot
            splash is shown. Releasing it earlier continues the normal boot. A
            released pin adds no delay to normal startup.

endmenu
```

## mosaico-tools/recovery/sdkconfig.defaults
```kconfig
CONFIG_IDF_TARGET="esp32s31"
CONFIG_IDF_EXPERIMENTAL_FEATURES=y
CONFIG_ESPTOOLPY_FLASHMODE_QIO=y
CONFIG_ESPTOOLPY_FLASHSIZE_16MB=y
CONFIG_PARTITION_TABLE_CUSTOM=y
CONFIG_PARTITION_TABLE_CUSTOM_FILENAME="partitions.csv"
CONFIG_PARTITION_TABLE_OFFSET=0x8000
```
